## conf/layer.conf
```bitbake
# We have a packages directory, add to BBFILES
BBPATH .= ":${LAYERDIR}"

BBFILES += "${LAYERDIR}/recipes-*/*/*.bb*"
BBFILES += "${LAYERDIR}/images/*.bb*"
BBFILES += "${LAYERDIR}/classes/*.bb*"

BBFILE_COLLECTIONS += "tlabp204x"
BBFILE_PATTERN_tlabp204x= "^${LAYERDIR}/"
BBFILE_PRIORITY_tlabp204x = "5"

LICENSE_PATH += "${LAYERDIR}/custom-licenses"

# Let us add layer-specific bbappends which are only applied when that
# layer is included in our configuration
BBFILES += "${@' '.join('${LAYERDIR}/dynamic-layers/%s/recipes*/*/*.bbappend' % layer \
               for layer in BBFILE_COLLECTIONS.split())}"
```

## conf/machine/include/e500mc.inc
```bitbake
TARGET_FPU = "hard"

require conf/machine/include/tune-ppce500mc.inc
require conf/machine/include/soc-family.inc

MACHINEOVERRIDES =. "e500mc:"

require conf/machine/include/qoriq-ppc.inc
```

## conf/machine/include/e500v2.inc
```bitbake
require conf/machine/include/tune-ppce500v2.inc
require conf/machine/include/soc-family.inc

MACHINEOVERRIDES =. "e500v2:"

require conf/machine/include/qoriq-ppc.inc
```

## conf/machine/include/qoriq.inc
```bitbake
# Provides the QorIQ common settings

PREFERRED_PROVIDER_virtual/kernel ?= "linux-qoriq"
PREFERRED_PROVIDER_virtual/bootloader ?= "u-boot-qoriq"
PREFERRED_PROVIDER_u-boot ?= "u-boot-qoriq"
PREFERRED_PROVIDER_cryptodev-linux = "cryptodev-qoriq-linux"
PREFERRED_PROVIDER_cryptodev-module = "cryptodev-qoriq-module"
PREFERRED_PROVIDER_cryptodev-tests = "cryptodev-qoriq-tests"
PREFERRED_PROVIDER_openssl = "openssl-qoriq"
PREFERRED_PROVIDER_qemu = "qemu-qoriq"

MACHINE_FEATURES = "keyboard pci ext2 ext3 serial"
MACHINE_EXTRA_RRECOMMENDS += "udev-rules-qoriq kernel-modules"

IMAGE_CLASSES += "image_types_uboot"
EXTRA_IMAGEDEPENDS += "u-boot"

MACHINEOVERRIDES =. "qoriq:"
```

## conf/machine/mpc8544ds.conf
```bitbake
#@TYPE: Machine
#@NAME: Freescale C293PCIE
#@SOC: c293pcie
#@DESCRIPTION: Machine configuration for Freescale C29x Crypto Coprocessor
#              PCI Express Adapter Platform with ppce500v2 core
#@MAINTAINER: Chunrong Guo <B40290@freescale.com>

MACHINEOVERRIDES =. "mpc85xx:"

require conf/machine/include/e500v2.inc

UBOOT_CONFIG ??= "nor"
# UBOOT_CONFIG ??= "spi secboot spi-secboot nor"
UBOOT_CONFIG[nor] = "MPC8544DS_config"
# UBOOT_CONFIG[spi] = "C29XPCIE_SPIFLASH_config"
# UBOOT_CONFIG[secboot] = "C29XPCIE_NOR_SECBOOT_config"
# UBOOT_CONFIG[spi-secboot] = "C29XPCIE_SPIFLASH_SECBOOT_config"

KERNEL_DEVICETREE ?= "${S}/arch/powerpc/boot/dts/mpc8544ds.dts"
KERNEL_DEFCONFIG ?= "${S}/arch/powerpc/configs/mpc85xx_defconfig"

JFFS2_ERASEBLOCK = "0x10000"
USE_VT ?= "0"
```

## conf/machine/tlabp204x.conf
```bitbake
#@TYPE: Machine
#@NAME: Freescale P2041RDB
#@SOC: p2041
#@DESCRIPTION: Machine configuration for Freescale QorIQ P2041 Reference
#              Design Board, rev2 silicon with ppce500mc core
#@MAINTAINER: Chunrong Guo <B40290@freescale.com>

MACHINEOVERRIDES =. "p2041:"

require conf/machine/include/e500mc.inc

UBOOT_CONFIG = "nor"
UBOOT_CONFIG[nor] = "TLABP204X_config"
UBOOT_CONFIG[nand] = "P2041RDB_NAND_config,,u-boot.pbl"
UBOOT_CONFIG[secure-boot] = "P2041RDB_SECURE_BOOT_config"
UBOOT_CONFIG[sdcard] = "P2041RDB_SDCARD_config,,u-boot.pbl"
UBOOT_CONFIG[spi] = "P2041RDB_SPIFLASH_config,,u-boot.pbl"
KERNEL_DEVICETREE ?= "fsl/p2041rdb.dtb fsl/p2041rdb-usdpaa.dtb \
    fsl/p2041rdb-usdpaa-shared-interfaces.dtb \
"
KERNEL_DEFCONFIG ?= "${S}/arch/powerpc/configs/corenet32_smp_defconfig"

JFFS2_ERASEBLOCK = "0x10000"

EXTRA_IMAGEDEPENDS += "fm-ucode"
USE_VT ?= "0"
```
